/dts-v1/;

/ {

	metadata {
		title = "Enable spidev on SPI1";
		compatible = "radxa,cubie-a7a", "radxa,cubie-a7z", "radxa,cubie-a7s";
		category = "misc";
		exclusive = "spi1", "PD11", "PD12", "PD13";
		description = "Enable spidev on SPI1 on\npin 21(MISO), 23(CLK), 19(MOSI), 24(CS0)";
	};

	fragment@0 {
		target = <0xffffffff>;

		__overlay__ {

			spi1@0 {
				pins = "PD11", "PD12", "PD13";
				function = "spi1";
				drive-strength = <0x0a>;
				phandle = <0x01>;
			};

			spi1@1 {
				pins = "PD10";
				function = "gpio_out";
				drive-strength = <0x0a>;
				phandle = <0x02>;
			};

			spi1@2 {
				pins = "PD11", "PD12", "PD13";
				function = "gpio_in";
				drive-strength = <0x0a>;
				phandle = <0x03>;
			};
		};
	};

	fragment@1 {
		target = <0xffffffff>;

		__overlay__ {
			clock-frequency = <0x2faf080>;
			pinctrl-0 = <0x01 0x01>;
			pinctrl-1 = <0x03>;
			pinctrl-names = "default", "sleep";
			sunxi,spi-bus-mode = <0x01>;
			sunxi,spi-cs-mode = <0x00>;
			status = "okay";

			spidev0 {
				compatible = "rohm,dh2228fv";
				reg = <0x00>;
				spi-max-frequency = <0x5f5e100>;
				spi-rx-bus-width = <0x01>;
				spi-tx-bus-width = <0x01>;
				status = "okay";
			};
		};
	};

	__symbols__ {
		spi1_pins_default = "/fragment@0/__overlay__/spi1@0";
		spi1_pins_cs = "/fragment@0/__overlay__/spi1@1";
		spi1_pins_sleep = "/fragment@0/__overlay__/spi1@2";
	};

	__fixups__ {
		pio = "/fragment@0:target:0";
		spi1 = "/fragment@1:target:0";
	};

	__local_fixups__ {

		fragment@1 {

			__overlay__ {
				pinctrl-0 = <0x00 0x04>;
				pinctrl-1 = <0x00>;
			};
		};
	};
};
